#include "Basic.h"
#include "drv_GPS.h"

#include "STS.h"
#include "Sensors_Backend.h"

#include "TM4C123GH6PM.h"
#include "uart.h"
#include "sysctl.h"
#include "gpio.h"
#include "pin_map.h"
#include "interrupt.h"
#include "hw_ints.h"
#include "hw_gpio.h"
#include "Timer.h"
#include "udma.h"

static uint16_t ubloxInit_SendCounter = 0;
static const unsigned char ubloxInit[] = {
		0xb5, 0x62, 0x06, 0x24, 0x24, 0x00,  0x05, 0x00,  0x07, 0x03,  0,0,0,0,0,0,0,0,0,0,0,0,0,0,0,0,0,0,0,0,0,0,0,0,0,0,0,0,0,0,0,0,  0x5d, 0xc9,	//NAV5
		0xB5, 0x62, 0x06, 0x08, 0x06, 0x00, 0x64, 0x00, 0x01, 0x00, 0x01, 0x00, 0x7A, 0x12,             // set rate to 10Hz
		
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		0xB5, 0x62, 0x06, 0x01, 0x03, 0x00, 0x01, 0x07, 0x01, 0x13, 0x51,           // set PVT MSG rate
		
		//set baudrate to 115200
		0xB5 , 0x62 , 0x06 , 0x00 , 0x14 , 0x00 , 0x01 , 0x00 , 0x00 , 0x00 , 0xD0 , 0x08 , 0x00 , 0x00 , 0x00 , 0xC2 , 0x01 , 0x00 , 0x07 , 0x00 , 0x01 , 0x00 , 0x00 , 0x00 , 0x00 , 0x00 , 0xBE , 0x72 ,	
		
};

static void GPS_Handler();
static void GPS_Server();
static inline void UbloxInit_StartSend()
{
	while( ( UART0->FR & (1<<5) ) == 0 )
		UART0->DR = ubloxInit[ ubloxInit_SendCounter++ ];
}

void init_drv_GPS()
{
	//使能Uart0引脚（Rx:PA0 Tx:PA1）
	SysCtlPeripheralEnable(SYSCTL_PERIPH_GPIOA);
	//使能UART0
	SysCtlPeripheralEnable(SYSCTL_PERIPH_UART0);
	
	//配置GPIO
	GPIOPinConfigure(GPIO_PA0_U0RX);
	GPIOPinConfigure(GPIO_PA1_U0TX);
	GPIOPinTypeUART(GPIOA_BASE, GPIO_PIN_0 | GPIO_PIN_1);//GPIO的UART模式配置
		
	//配置Uart
	UARTConfigSetExpClk(UART0_BASE, SysCtlClockGet() , 115200,			
	                   (UART_CONFIG_WLEN_8 
										| UART_CONFIG_STOP_ONE 
										|	UART_CONFIG_PAR_NONE));	
	
//	while(1)
//	{
//		for( uint16_t i = 0 ; i < sizeof( ubloxInit ) ; ++i )
//		{
//			while( (UART0->FR & (1<<5)) != 0 );
//			UART0->DR = ubloxInit[i];
//		}
//		UARTConfigSetExpClk(UART0_BASE, SysCtlClockGet() , 57600,			
//	                   (UART_CONFIG_WLEN_8 
//										| UART_CONFIG_STOP_ONE 
//										|	UART_CONFIG_PAR_NONE));	
//		delay(1.0f);
//		
//	}
	UARTFIFOEnable( UART0_BASE );
	UARTIntEnable(UART0_BASE,UART_INT_RX | UART_INT_RT | UART_INT_TX);//使能UART0发送接收中断		
	UARTIntRegister(UART0_BASE,GPS_Handler);//UART中断地址注册	
	IntPrioritySet(INT_UART0, INT_PRIO_7);
	
	STS_Add_Task( STS_Task_Trigger_Mode_RoughTime , 1.0f / 10 , 0 , GPS_Server );
}

typedef struct
{
	uint8_t CLASS;
	uint8_t ID;
	uint16_t length;
	
	uint32_t iTOW;
	uint16_t y;
	uint8_t month;
	uint8_t day;
	uint8_t hour;
	uint8_t min;
	uint8_t sec;
	uint8_t valid;
	uint32_t t_Acc;
	int32_t nano;
	uint8_t fix_type;
	uint8_t flags;
	uint8_t flags2;
	uint8_t numSV;
	int32_t lon;
	int32_t lat;
	int32_t height;
	int32_t hMSL;
	uint32_t hAcc;
	uint32_t vAcc;
	int32_t velN;
	int32_t velE;
	int32_t velD;
	int32_t gSpeed;
	int32_t headMot;
	uint32_t sAcc;
	uint32_t headAcc;
	uint16_t pDOP;
	uint8_t res1[6];
	int32_t headVeh;
	uint8_t res2[4];
}__attribute__((packed)) UBX_NAV_PVT_Pack;
typedef enum
{
	//在指定波特率下发送初始化信息
	GPS_Scan_Baud9600 = 9600 ,
	GPS_Scan_Baud38400 = 38400 ,
	GPS_Scan_Baud115200 = 115200 ,
	
	//检查是否设置成功
	GPS_Check_Baud ,
	//在当前波特率下再次发送配置
	GPS_ResendConfig ,
}GPS_Scan_Operation;
static GPS_Scan_Operation current_scan_operation = GPS_Scan_Baud115200;
static TIME GPS_stable_start_time = {0};
static bool GPS_Check_Success = false;
static void GPS_Server()
{
	static unsigned short operation_counter = 0;
	static GPS_Scan_Operation last_Scan_Operation = GPS_Scan_Baud115200;
		
	if( GetPositionSensor(default_gps_sensor_index)->present == false )
	{
		
		switch( current_scan_operation )
		{
			
			case GPS_Scan_Baud9600:
			case GPS_Scan_Baud38400:
			case GPS_Scan_Baud115200:
			{
				if( operation_counter == 0 )
				{
					//配置Uart
					UARTConfigSetExpClk( UART0_BASE , SysCtlClockGet() , (unsigned int)current_scan_operation,			
	                   (UART_CONFIG_WLEN_8 
										| UART_CONFIG_STOP_ONE 
										|	UART_CONFIG_PAR_NONE));	
				}					
				else if( operation_counter == 1 )
				{
					//发送初始设置
					UbloxInit_StartSend();
				}
				else if( operation_counter < ceilf( 144000.0f / (float)current_scan_operation ) )
				{
				}
				else
				{
					operation_counter = 0;
					last_Scan_Operation = current_scan_operation;
					current_scan_operation = GPS_Check_Baud;
					
					//配置Uart
					UARTConfigSetExpClk(UART0_BASE, SysCtlClockGet() , 115200,			
	                   (UART_CONFIG_WLEN_8 
										| UART_CONFIG_STOP_ONE 
										|	UART_CONFIG_PAR_NONE));
					GPS_Check_Success = false;
					
					break;
				}
					
				++operation_counter;
				break;
			}
			
			case GPS_Check_Baud:
			{
				if( operation_counter < 10 )
				{
					if( GPS_Check_Success )
					{
						current_scan_operation = GPS_ResendConfig;
						operation_counter = 0;						
						break;
					}
				}
				else
				{
					switch( last_Scan_Operation )
					{
						case GPS_Scan_Baud9600:
							current_scan_operation = GPS_Scan_Baud38400;
							break;
						case GPS_Scan_Baud38400:
							current_scan_operation = GPS_Scan_Baud115200;
							break;
						case GPS_Scan_Baud115200:
							current_scan_operation = GPS_Scan_Baud9600;
							break;
						
						default:
							break;
					}
					operation_counter = 0;
					break;
				}
				
				++operation_counter;
				break;
			}
			
			case GPS_ResendConfig:
			{
				if( operation_counter == 0 )
				{
					//配置Uart
					UARTConfigSetExpClk(UART0_BASE, SysCtlClockGet() , 115200,			
	                   (UART_CONFIG_WLEN_8 
										| UART_CONFIG_STOP_ONE 
										|	UART_CONFIG_PAR_NONE));	
				}					
				else if( operation_counter == 1 )
				{
					//再次发送初始设置
					UbloxInit_StartSend();
				}
				else if( operation_counter < 3 )
				{
				}
				else
				{
					//注册传感器
					PositionSensorRegister( default_gps_sensor_index , \
																	Position_Sensor_Type_GlobalPositioning , \
																	Position_Sensor_DataType_sv_xy , \
																	Position_Sensor_frame_ENU , \
																	0.1f , \
																	true );
					operation_counter = 0;
					current_scan_operation = GPS_Scan_Baud9600;
				}
				++operation_counter;
				
				break;
			}
			
		}
	}
	else
	{
		//GPS present
		const Position_Sensor* gps = GetPositionSensor( default_gps_sensor_index );
		if( get_pass_time( gps->last_update_time ) > 2.0f )
		{
			//GPS disconnected
			PositionSensorUnRegister( default_gps_sensor_index );
			Time_set_inValid( &GPS_stable_start_time );
			
			current_scan_operation = GPS_Scan_Baud115200;
			operation_counter = 0;
			last_Scan_Operation = GPS_Scan_Baud115200;
		}
	}
}

static void GPS_Handler()
{
	UARTIntClear( UART0_BASE , UART_INT_OE | UART_INT_RT );
	UARTRxErrorClear( UART0_BASE );
	UARTIntClear( UART0_BASE , UART_INT_TX );
	
	//发送UbloxInit
	if( ubloxInit_SendCounter > 0 )
	{
		if( ubloxInit_SendCounter >= sizeof( ubloxInit ) )
			ubloxInit_SendCounter = 0;
		else
		{		
			while( ( UART0->FR & (1<<5) ) == 0 )
				UART0->DR = ubloxInit[ ubloxInit_SendCounter++ ];
		}
	}
	
	//状态机接收数据
	while( ( UART0->FR & (1<<4) ) == false	)
	{
		//接收
		uint8_t r_data = UART0->DR & 0xff;
		
		if( GetPositionSensor( default_gps_sensor_index )->present == true || current_scan_operation == GPS_Check_Baud )
		{
			__attribute__((aligned(4))) static unsigned char frame_datas[150];
			static unsigned int frame_datas_ind = 0;
			static unsigned short frame_datas_length;
			static unsigned char read_state = 0;	//0=

			static unsigned char CK_A , CK_B;	//checksum
			
			frame_datas[ frame_datas_ind++ ] = r_data;
			switch( read_state )
			{
				case 0:	//找包头
				{				
					if( frame_datas_ind == 1 )
					{
						if( r_data != 0xb5 )
							frame_datas_ind = 0;
					}
					else
					{
						if( r_data == 0x62 )	//header found
						{
							read_state = 1;
							frame_datas_ind = 0;
							CK_A = CK_B = 0;	//reset checksum
						}		
						else
							frame_datas_ind = 0;
					}	
					break;
				}
				case 1:	//读Class ID和包长度
				{
					CK_A += r_data;
					CK_B += CK_A;
					if( frame_datas_ind == 4 )
					{
						frame_datas_length = (*(unsigned short*)&frame_datas[2]) + 4;
						if( frame_datas_length > 4 && frame_datas_length < 150 )
							read_state = 2;						
						else
							read_state = frame_datas_ind = 0;
					}
					break;
				}
				case 2:	//读包内容
				{
					CK_A += r_data;
					CK_B += CK_A;
					
					if( frame_datas_ind == frame_datas_length )
					{
						//payload read completed
						read_state = 3;
					}
					break;
				}
				case 3://校验
				{
					if( frame_datas_ind == frame_datas_length + 1 )
					{
						if( r_data != CK_A )
							read_state = frame_datas_ind = 0;
					}
					else
					{
						if( r_data == CK_B )
						{
							//校验成功
							const Position_Sensor* gps = GetPositionSensor( default_gps_sensor_index);
							
							if( gps->present == true )
							{
								if( frame_datas[0] == 0x01 && frame_datas[1] == 0x07 )	//Navigation Position Velocity Time frame
								{									
									UBX_NAV_PVT_Pack* pack = (UBX_NAV_PVT_Pack*)frame_datas;
				
									
									bool available = gps->available;
									bool z_available = (gps->sensor_DataType == Position_Sensor_DataType_sv_xyz);
									if( ((pack->flags & 1) == 1) && (pack->fix_type == 0x03) && (pack->numSV >= 5) )
									{
										if( gps->available == false )
										{
											if( pack->hAcc < 2500 )
											{
												if( Time_isValid( GPS_stable_start_time ) == false )
													GPS_stable_start_time = get_TIME_now();
												else if( get_pass_time( GPS_stable_start_time ) > 3.0f )
												{
													available = true;
													Time_set_inValid( &GPS_stable_start_time );
												}
											}
											else
												Time_set_inValid( &GPS_stable_start_time );
										}
										else
										{
											if( pack->hAcc > 3500 )
												available = z_available = false;
										}
										
									}
									else
										available = z_available = false;
									
									if( available )
									{
										if( gps->sensor_DataType == Position_Sensor_DataType_sv_xyz )
										{
											if( pack->vAcc > 5500 )
												z_available = false;
										}
										else
										{
											if( pack->vAcc < 3800 )
												z_available = true;
										}
										
										vector3_float velocity;
										velocity.y = pack->velN * 0.1f;	//North
										velocity.x = pack->velE * 0.1f;	//East
										velocity.z = -pack->velD * 0.1f;	//Up
										
										vector3_double position_Global;
										position_Global.x = pack->lat * 1e-7;
										position_Global.y = pack->lon * 1e-7;
										//position_Global.z = pack->hMSL * 1e-1;
										if( gps->available == false && available == true )
											position_Global.z = pack->hMSL * 1e-1;
										else
											position_Global.z = gps->position.z + get_pass_time( gps->last_update_time )*velocity.z;
										
										if( z_available )
											PositionSensorChangeDataType( default_gps_sensor_index , Position_Sensor_DataType_sv_xyz );
										else
											PositionSensorChangeDataType( default_gps_sensor_index , Position_Sensor_DataType_sv_xy );	
										PositionSensorUpdatePositionGlobalVel( default_gps_sensor_index , position_Global , velocity , true , 0.15f );
																	
									}
									else
										PositionSensorSetInavailable( default_gps_sensor_index );
									
								}	//PVT pack								
								
							}//GPS present
							else if( current_scan_operation == GPS_Check_Baud )
							{
								if( frame_datas[0] == 0x01 && frame_datas[1] == 0x07 )	//Navigation Position Velocity Time frame
									GPS_Check_Success = true;
							}							
						}
						read_state = frame_datas_ind = 0;					
					}
				}
			}
		}
	}
}
