#include "oledfont.h" 

#include <stdlib.h>
#include <stdio.h>
#include "AC_Math.h"

/*清屏*/
 void FDraw_Clear( unsigned char Image[8][128] )
 {
	 memset( Image , 0 , 8*128 );
 }
 void FDraw_ClearLines( unsigned char Image[8][128] , unsigned char start , unsigned char count )
 {
	 if( start + count > 8 )
		 return;
	 for( unsigned char i = start ; i < start + count ; ++i )
		memset( Image[i] , 0 , 1*128 );
 }
/*清屏*/

/*Logo*/
	static const unsigned char Font_Logo[8][64] = 
	{	
		
		{0x00,0x00,0x00,0x00,0x00,0x00,0x00,0x00,0x00,0x00,0x00,0x00,0x00,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0x00,0x00},
		{0x00,0x00,0x00,0x00,0x00,0x00,0x00,0x00,0x00,0x00,0x00,0x00,0x01,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0x00,0x00},
		{0x18,0x16,0x11,0x10,0x10,0x10,0x11,0x12,0x14,0x18,0x30,0x50,0x90,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0x14,0x18},
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		{0x00,0x00,0x00,0x00,0x00,0x00,0x00,0x00,0x00,0x00,0x00,0x00,0x00,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0x00,0x00},

//		{0x00,0x00,0x00,0x00,0x00,0x00,0x00,0x00,0x00,0x00,0x00,0x00,0x00,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0x00,0x00},
//		{0x00,0x00,0x00,0x00,0x00,0x00,0x00,0x00,0x00,0x00,0x00,0x00,0x00,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0x00,0x00},
//		{0x00,0x00,0x00,0x00,0x00,0x00,0x00,0x00,0x00,0x00,0x00,0x00,0x00,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0x00,0x00},
//		{0x00,0x00,0x00,0x00,0x00,0x00,0x00,0x00,0x00,0x00,0x00,0x00,0x00,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0x00,0x00},
//		{0x00,0x00,0x00,0x00,0x00,0x00,0x00,0x00,0x00,0x00,0x00,0x00,0x00,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0x00,0x00},
//		{0x00,0x00,0x00,0x00,0x00,0x00,0x00,0x00,0x00,0x00,0x00,0x03,0x0F,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0x00,0x00},
//		{0x00,0x00,0x00,0x00,0x00,0x06,0x06,0x0E,0x1E,0x3E,0xFE,0xFE,0xFE,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0x00,0x00},
//		{0x00,0x00,0x00,0x00,0x00,0x00,0x00,0x00,0x00,0x00,0x00,0x00,0x00,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0x00,0x00},
	};
	static const unsigned char Font_Logo_Rows = sizeof(Font_Logo) / sizeof(Font_Logo[0]);
	static const unsigned char Font_Logo_Columns = sizeof(Font_Logo[0]) / sizeof(Font_Logo[0][0]);
	bool FDraw_Logo( unsigned char Image[8][128] , unsigned char StRow , unsigned char StColumn )
	{
		if( Font_Logo_Rows + StRow > 8 )
			return false;
		if( Font_Logo_Columns + StColumn > 128 )
			return false;
		
		for( unsigned char i = 0 ; i < Font_Logo_Rows ; ++i )
			memcpy( &Image[StRow + i][StColumn] , Font_Logo[i] , Font_Logo_Columns );
		return true;
	}
/*Logo*/

/*ASCII 32-123*/
	static const unsigned char Font_8x6[][6] =
	{
		{0x00, 0x00, 0x00, 0x00, 0x00, 0x00},// sp
		{0x00, 0x00, 0x00, 0xF4, 0x00, 0x00},// !
		{0x00, 0x00, 0xE0, 0x00, 0xE0, 0x00},// "
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		{0x00, 0x22, 0x26, 0x2A, 0x32, 0x22},// z
	};
	static const unsigned char Font_8x6_Count = sizeof(Font_8x6) / sizeof(Font_8x6[0]);
	bool FDraw_Font8x6( unsigned char Image[8][128] , const char* str , unsigned char StRow , unsigned char StColumn )
	{
		if( StRow > 7 )
			return false;
		signed short length = -1;
		for( unsigned char i = 0 ; i < 255 ; ++i )
		{
			if( str[i] == '\0' )
			{
				length = i;
				break;
			}
		}
		if( length < 0 )
			return false;
		if( StColumn + length*6 > 128 )
			return false;
		
		for( unsigned char i = 0 ; i < length ; ++i )
		{
			unsigned char FontInd = str[i];
			if( FontInd < 32 || FontInd >= 32 + Font_8x6_Count )
				FontInd = 0;
			else
				FontInd -= 32;
			memcpy( &Image[StRow][StColumn+i*6] , Font_8x6[FontInd] , 6 );
		}
		
		return true;
	}
	
	static const unsigned char Font_16x8[][2][8]=
	{
		{{0x00,0x00,0x00,0x00,0x00,0x00,0x00,0x00},{0x00,0x00,0x00,0x00,0x00,0x00,0x00,0x00}},// 0
		{{0x00,0x00,0x00,0x1F,0x00,0x00,0x00,0x00},{0x00,0x00,0x00,0xCC,0x0C,0x00,0x00,0x00}},//! 1
		{{0x00,0x08,0x30,0x60,0x08,0x30,0x60,0x00},{0x00,0x00,0x00,0x00,0x00,0x00,0x00,0x00}},//" 2
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		{{0x00,0x60,0x80,0x80,0x40,0x40,0x20,0x20},{0x00,0x00,0x00,0x00,0x00,0x00,0x00,0x00}},//~ 94
	};
	static const unsigned char Font_16x8_Count = sizeof(Font_16x8) / sizeof(Font_16x8[0]);
	bool FDraw_Font16x8( unsigned char Image[8][128] , const char* str , unsigned char StRow , unsigned char StColumn )
	{
		if( StRow > 8-2 )
			return false;
		signed short length = -1;
		for( unsigned char i = 0 ; i < 255 ; ++i )
		{
			if( str[i] == '\0' )
			{
				length = i;
				break;
			}
		}
		if( length < 0 )
			return false;
		if( StColumn + length*8 > 128 )
			return false;
		
		for( unsigned char i = 0 ; i < length ; ++i )
		{
			unsigned char FontInd = str[i];
			if( FontInd < 32 || FontInd >= 32 + Font_8x6_Count )
				FontInd = 0;
			else
				FontInd -= 32;
			memcpy( &Image[StRow][StColumn+i*8] , Font_16x8[FontInd][0] , 8 );
			memcpy( &Image[StRow+1][StColumn+i*8] , Font_16x8[FontInd][1] , 8 );
		}
		
		return true;
	}
/*ASCII 32-123*/

/*勾叉点*/
	static const unsigned char Font_Tick8x6[] = {0x04,0x06,0x03,0x1C,0x70,0xC0};
	static const unsigned char Font_Cross8x6[] = {0x42,0x24,0x18,0x18,0x24,0x42};
	bool FDraw_TickCross8x6( unsigned char Image[8][128] , bool Tick, unsigned char StRow , unsigned char StColumn )
	{
		if( StRow > 8-1 )
			return false;
		signed short length = -1;
		if( StColumn + 6 > 128 )
			return false;
		if( Tick )
			memcpy( &Image[StRow][StColumn] , Font_Tick8x6 , 6 );
		else
			memcpy( &Image[StRow][StColumn] , Font_Cross8x6 , 6 );
		return true;
	}
	
	static const unsigned char Font_Point8x6[] = {0x00,0x00,0x18,0x18,0x00,0x00};
	bool FDraw_Point8x6( unsigned char Image[8][128] , unsigned char StRow , unsigned char StColumn )
	{
		if( StRow > 8-1 )
			return false;
		signed short length = -1;
		if( StColumn + 6 > 128 )
			return false;
		memcpy( &Image[StRow][StColumn] , Font_Point8x6 , 6 );
		return true;
	}
/*勾叉点*/
	
/*画竖直进度条*/
	bool FDraw_VerticalProgressBar24x14( unsigned char Image[8][128] , float progress , unsigned char StRow , unsigned char StColumn )
	{
		if( StRow > 8-3 )
			return false;
		signed short length = -1;
		if( StColumn + 14 > 128 )
			return false;
		
		//求进度显示格子数
		progress += 20;
		if( progress > 140 )
			progress = 140;
		else if( progress < 0 )
			progress = 0;
		unsigned int progress_b = progress / 140.0f * 24;
		progress_b = ( 1 << progress_b ) - 1;
		
		//前两行（空行）
		memset( &Image[StRow+0][StColumn] , 0x90 , 2 );
		memset( &Image[StRow+1][StColumn] , 0x18 , 2 );
		memset( &Image[StRow+2][StColumn] , 0x09 , 2 );	
		//前两行（空行）
		memset( &Image[StRow+0][StColumn+2] , 0x80 , 1 );
		memset( &Image[StRow+1][StColumn+2] , 0x00 , 1 );
		memset( &Image[StRow+2][StColumn+2] , 0x01 , 1 );	
		//进度条
		memset( &Image[StRow+0][StColumn+3] , (progress_b>>16) | 0x80 , 2 );
		memset( &Image[StRow+1][StColumn+3] , (progress_b>>8) | 0x0 , 2 );
		memset( &Image[StRow+2][StColumn+3] , (progress_b>>0) | 0x1 , 2 );
		//前两行（空行）
		memset( &Image[StRow+0][StColumn+5] , 0x80 , 1 );
		memset( &Image[StRow+1][StColumn+5] , 0x00 , 1 );
		memset( &Image[StRow+2][StColumn+5] , 0x01 , 1 );	
		//后两行（空行）
		memset( &Image[StRow+0][StColumn+6] , 0x90 , 2 );
		memset( &Image[StRow+1][StColumn+6] , 0x18 , 2 );
		memset( &Image[StRow+2][StColumn+6] , 0x09 , 2 );
		
		//写进度数字
		char num_str[5];
		sprintf( num_str , "%3.0f" , progress - 20 );
		unsigned int FontInd;
		//0
		FontInd = num_str[0];
		if( FontInd < 32 || FontInd >= 32 + Font_8x6_Count )
			FontInd = 0;
		else
			FontInd -= 32;
		memcpy( &Image[StRow+0][StColumn+8] , Font_8x6[FontInd] , 6 );
		//1
		FontInd = num_str[1];
		if( FontInd < 32 || FontInd >= 32 + Font_8x6_Count )
			FontInd = 0;
		else
			FontInd -= 32;
		memcpy( &Image[StRow+1][StColumn+8] , Font_8x6[FontInd] , 6 );
		//2
		FontInd = num_str[2];
		if( FontInd < 32 || FontInd >= 32 + Font_8x6_Count )
			FontInd = 0;
		else
			FontInd -= 32;
		memcpy( &Image[StRow+2][StColumn+8] , Font_8x6[FontInd] , 6 );
		
		return true;
	}
/*画竖直进度条*/