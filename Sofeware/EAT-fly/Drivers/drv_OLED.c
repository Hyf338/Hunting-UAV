#include "Basic.h"
#include "drv_OLED.h"

#include "TM4C123GH6PM.h"
#include <string.h>
#include <stdint.h>
#include <stdbool.h>
#include "sysctl.h"
#include "pin_map.h"
#include "gpio.h"
#include "ssi.h"
#include "Basic.h"
#include "oledfont.h" 
#include "udma.h"
#include "interrupt.h"
#include "hw_ints.h"
#include "InteractiveInterface.h"

static inline void OLED_DC_LOW() { GPIOPinWrite(GPIOF_BASE, GPIO_PIN_4, 0); }
static inline void OLED_DC_HIGH() { GPIOPinWrite(GPIOF_BASE, GPIO_PIN_4, GPIO_PIN_4); }
//static inline void OLED_DC_LOW() { GPIOPinWrite(GPIOE_BASE, GPIO_PIN_2, 0); }
//static inline void OLED_DC_HIGH() { GPIOPinWrite(GPIOE_BASE, GPIO_PIN_2, GPIO_PIN_2); }

static inline void OLED_RST_LOW() { GPIOPinWrite(GPIOE_BASE, GPIO_PIN_3, 0); }
static inline void OLED_RST_HIGH() { GPIOPinWrite(GPIOE_BASE, GPIO_PIN_3, GPIO_PIN_3); }

/*OLED状态机*/
	//发送缓冲区
	static uint8_t SSI0_TX_buf[10];

	static bool NeedUpdate = false;

	//OLED状态机状态：
	//-1：当前无操作
	//0,2,4,6,8,10,12,14：当前操作为发送数据指令，0第一行，1第二行...
	//1,3,5,7,9,11,13,15：当前操作为发送数据指令，1第一行，2第二行...
	static int16_t current_uDMA_Send_Step = -1;
		
	//OLED状态机DMA发送完成中断函数
	static void OLED_Sent_Handler();
/*OLED状态机*/

/*OLED静态操作函数*/
	static void OLED_Write_Byte(uint8_t dat);
	/*******write data and send****/
	static void OLED_Write_Data(uint8_t dat);
	/******write command and send********/
	static void OLED_Write_Cmd(uint8_t cmd);
	
//	static void OLED_Show(unsigned char  Oled_array[8][128]);
//	static void OLED_Display_On(void);
//	static void OLED_Clear(void);
/*OLED静态操作函数*/

//LED图像矩阵
static unsigned char OLED_Image[8][128] = 
{
	{0x00,0x00,0x00,0x00,0x00,0x00,0x00,0x00,0x00,0x00,0x00,0x00,0x00,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0x00,0x00},
	{0x00,0x00,0x00,0x00,0x00,0x00,0x00,0x00,0x00,0x00,0x00,0x00,0x00,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0x00,0x00},
	{0x00,0x00,0x00,0x00,0x00,0x00,0x00,0x00,0x00,0x00,0x00,0x00,0x00,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0x00,0x00},
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	{0x00,0x00,0x00,0x00,0x00,0x00,0x00,0x00,0x00,0x00,0x00,0x00,0x00,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0x00,0x00},
};

void init_drv_OLED()
{
	//打开SSI时钟
	SysCtlPeripheralEnable(SYSCTL_PERIPH_SSI0);
	//打开GPIOA时钟：PA2(SSI0CLK)	PA5(SSI0TX)
  SysCtlPeripheralEnable(SYSCTL_PERIPH_GPIOA);
	//打开GPIOE时钟：PE3(OLED RST)
	SysCtlPeripheralEnable(SYSCTL_PERIPH_GPIOE);
	//打开GPIOF时钟：PF4(OLED DC)
	SysCtlPeripheralEnable(SYSCTL_PERIPH_GPIOF);
	
	//配置IO口
  GPIOPinTypeGPIOOutput(GPIOE_BASE, GPIO_PIN_3);		
	
	GPIOPinTypeGPIOOutput(GPIOF_BASE, GPIO_PIN_4);	
//	GPIOPinTypeGPIOOutput(GPIOE_BASE, GPIO_PIN_2);	
	
	GPIOPinTypeSSI(GPIOA_BASE,GPIO_PIN_2|GPIO_PIN_5);
	GPIOPinConfigure(GPIO_PA2_SSI0CLK);	
	GPIOPinConfigure(GPIO_PA5_SSI0TX);
	
	//配置SPI时钟为1mhz
	SSIConfigSetExpClk(SSI0_BASE, SysCtlClockGet(), SSI_FRF_MOTO_MODE_0,  SSI_MODE_MASTER, 1000000,  8);
	SSI0->CR1 |= (1<<4);

	//开启SSI0
  SSIEnable(SSI0_BASE);
	
	/*OLED初始化*/
		OLED_RST_LOW();
		delay(0.2f);
		OLED_RST_HIGH(); 
	
		OLED_Write_Cmd(0xAE); //关闭显示
		OLED_Write_Cmd(0xD5); //设置时钟分频因子,震荡频率
		OLED_Write_Cmd(80);   //[3:0],分频因子;[7:4],震荡频率
		OLED_Write_Cmd(0xA8); //设置驱动路数
		OLED_Write_Cmd(0X3F); //默认0X3F(1/64) 
		OLED_Write_Cmd(0xD3); //设置显示偏移
		OLED_Write_Cmd(0X00); //默认为0

		OLED_Write_Cmd(0x40); //设置显示开始行 [5:0],行数.
																
		OLED_Write_Cmd(0x8D); //电荷泵设置
		OLED_Write_Cmd(0x14); //bit2，开启/关闭
		OLED_Write_Cmd(0x20); //设置内存地址模式
		OLED_Write_Cmd(0x02); //[1:0],00，列地址模式;01，行地址模式;10,页地址模式;默认10;
		OLED_Write_Cmd(0xA1); //段重定义设置,bit0:0,0->0;1,0->127;
		OLED_Write_Cmd(0xC0); //设置COM扫描方向;bit3:0,普通模式;1,重定义模式 COM[N-1]->COM0;N:驱动路数
		OLED_Write_Cmd(0xDA); //设置COM硬件引脚配置
		OLED_Write_Cmd(0x12); //[5:4]配置
			 
		OLED_Write_Cmd(0x81); //对比度设置
		OLED_Write_Cmd(0xEF); //1~255;默认0X7F (亮度设置,越大越亮)
		OLED_Write_Cmd(0xD9); //设置预充电周期
		OLED_Write_Cmd(0xf1); //[3:0],PHASE 1;[7:4],PHASE 2;
		OLED_Write_Cmd(0xDB); //设置VCOMH 电压倍率
		OLED_Write_Cmd(0x30); //[6:4] 000,0.65*vcc;001,0.77*vcc;011,0.83*vcc;

		OLED_Write_Cmd(0xA4); //全局显示开启;bit0:1,开启;0,关闭;(白屏/黑屏)
		OLED_Write_Cmd(0xA6); //设置显示方式;bit0:1,反相显示;0,正常显示	    						   
		OLED_Write_Cmd(0xAF); //开启显示	 
		
		//OLED_Show( OLED_Image );
		//OLED_Display_On();
	/*OLED初始化*/
	
	//配置DMA发送
	uDMAChannelControlSet( UDMA_PRI_SELECT | UDMA_CH11_SSI0TX , \
		UDMA_SIZE_8 | UDMA_SRC_INC_8 | UDMA_DST_INC_NONE | UDMA_ARB_1 );
	SSIDMAEnable( SSI0_BASE , SSI_DMA_TX );
	SSIIntRegister( SSI0_BASE , OLED_Sent_Handler );
	IntPrioritySet( INT_SSI0 , INT_PRIO_5 );
	IntEnable( INT_SSI0 );
	uDMAChannelAssign(UDMA_CH11_SSI0TX  );	

	OLED_Clear();
	FDraw_Logo( OLED_Image , 0 , 0 );
	FDraw_Font16x8( OLED_Image , "ETAfly" , 0 , 64 );
	FDraw_Font16x8( OLED_Image , "EDU" , 2 , 100 );
	OLED_Update();
}

/*OLED 接口函数*/
	//刷新屏幕
	void OLED_Update()
	{
		if( current_uDMA_Send_Step >= 0 )
		{
			NeedUpdate = true;
			if( current_uDMA_Send_Step >= 0 )
				return;
			NeedUpdate = false;
		}
		
		current_uDMA_Send_Step = 0;
		OLED_DC_LOW();
		SSI0_TX_buf[0] = 0xb0+7-0;
		SSI0_TX_buf[1] = 0x00;
		SSI0_TX_buf[2] = 0x10;
		uDMAChannelTransferSet( UDMA_PRI_SELECT | UDMA_CH11_SSI0TX , \
			UDMA_MODE_BASIC , SSI0_TX_buf , (void*)&(SSI0->DR) , 3 );
		uDMAChannelEnable( UDMA_CH11_SSI0TX );
			
	}
	
	//清屏
	void OLED_Clear()
	{
		FDraw_Clear( OLED_Image );
	}
	void OLED_Clear_Lines( unsigned char start , unsigned char count )
	{
		FDraw_ClearLines( OLED_Image , start, count );
	}
	
	//写8x6文字
	bool OLED_Draw_Str8x6( const char* str , unsigned char StRow , unsigned char StColumn )
	{
		return FDraw_Font8x6( OLED_Image , str , StRow , StColumn );
	}	
	//写16x8文字
	bool OLED_Draw_Str16x8( const char* str , unsigned char StRow , unsigned char StColumn )
	{	
		return FDraw_Font16x8( OLED_Image , str , StRow , StColumn );
	}
	
	//画勾叉
	bool OLED_Draw_TickCross8x6( bool Tick, unsigned char StRow , unsigned char StColumn )
	{
		return FDraw_TickCross8x6( OLED_Image , Tick , StRow , StColumn );
	}
	//画点
	bool OLED_Draw_Point8x6( unsigned char StRow , unsigned char StColumn )
	{
		return FDraw_Point8x6( OLED_Image , StRow , StColumn );
	}
	
	//画竖直进度条
	bool OLED_Draw_VerticalProgressBar24x14( float progress , unsigned char StRow , unsigned char StColumn )
	{
		return FDraw_VerticalProgressBar24x14( OLED_Image , progress , StRow , StColumn );
	}
/*OLED 接口函数*/

static void OLED_Sent_Handler()
{
	if( current_uDMA_Send_Step < 0 )
		return;
	
	if( (current_uDMA_Send_Step & 1) == 0 )
	{
		//偶数，已发送数据指令
		++current_uDMA_Send_Step;
		//发送行数据
		OLED_DC_HIGH();
		uDMAChannelTransferSet( UDMA_PRI_SELECT | UDMA_CH11_SSI0TX , \
			UDMA_MODE_BASIC , OLED_Image[current_uDMA_Send_Step>>1] , (void*)&(SSI0->DR) , 128 );
		uDMAChannelEnable( UDMA_CH11_SSI0TX );
	}
	else
	{
		//奇数，已发送数据
		if( current_uDMA_Send_Step >= 15 )
		{	//发送完成
			if( NeedUpdate )
			{
				NeedUpdate = false;
				current_uDMA_Send_Step = 0;
				OLED_DC_LOW();
				SSI0_TX_buf[0] = 0xb0+7-0;
				SSI0_TX_buf[1] = 0x00;
				SSI0_TX_buf[2] = 0x10;
				uDMAChannelTransferSet( UDMA_PRI_SELECT | UDMA_CH11_SSI0TX , \
					UDMA_MODE_BASIC , SSI0_TX_buf , (void*)&(SSI0->DR) , 3 );
				uDMAChannelEnable( UDMA_CH11_SSI0TX );
			}
			else
				current_uDMA_Send_Step = -1;
			return;
		}
		++current_uDMA_Send_Step;
		//发送数据数据指令
		OLED_DC_LOW();
		unsigned char current_row = current_uDMA_Send_Step >> 1;
		SSI0_TX_buf[0] = 0xb0+7-current_row;
		SSI0_TX_buf[1] = 0x00;
		SSI0_TX_buf[2] = 0x10;
		uDMAChannelTransferSet( UDMA_PRI_SELECT | UDMA_CH11_SSI0TX , \
			UDMA_MODE_BASIC , SSI0_TX_buf , (void*)&(SSI0->DR) , 3 );
		uDMAChannelEnable( UDMA_CH11_SSI0TX );
	}
}

/*OLED静态操作函数*/
	/****send data******/
	static void OLED_Write_Byte(uint8_t dat)
	{
		SSIDataPut(SSI0_BASE , dat);
		while(SSIBusy(SSI0_BASE));
	}
	/*******write data and send****/
	static void OLED_Write_Data(uint8_t dat)
	{
			OLED_DC_HIGH();
			OLED_Write_Byte(dat);
	}
	/******write command and send********/
	static void OLED_Write_Cmd(uint8_t cmd)
	{
			OLED_DC_LOW();
			OLED_Write_Byte(cmd);
	}
	
//	static void OLED_Show(unsigned char  Oled_array[8][128])
//	{
//		unsigned char i,n;
//		for(i=0;i<8;i++)  
//		{  
//			OLED_Write_Cmd (0xb0+7-i);    //设置页地址（0~7）
//			OLED_Write_Cmd (0x00);      //设置显示位置—列低地址
//			OLED_Write_Cmd (0x10);      //设置显示位置—列高地址   
//			for(n=0;n<128;n++) OLED_Write_Data(Oled_array[i][n]); 
//		}	
//	}
//	//开启OLED显示    
//	static void OLED_Display_On(void)
//	{
//		OLED_Write_Cmd(0X8D);  //SET DCDC命令
//		OLED_Write_Cmd(0X14);  //DCDC ON
//		OLED_Write_Cmd(0XAF);  //DISPLAY ON
//	}
//	//清屏函数,清完屏,整个屏幕是黑色的!和没点亮一样!!!	  
//	static void OLED_Clear(void)  
//	{  
//		unsigned char i,n;
//		for(i=0;i<8;i++)  
//		{ 
//			OLED_Write_Cmd (0xb0+i);    //设置页地址（0~7）
//			OLED_Write_Cmd (0x00);      //设置显示位置—列低地址
//			OLED_Write_Cmd (0x10);      //设置显示位置—列高地址   
//			for(n=0;n<128;n++) OLED_Write_Data(0); 
//		}
//	}
/*OLED静态操作函数*/